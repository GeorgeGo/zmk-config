## config/west.yml
```yaml
manifest:
  remotes:
    - name: zmkfirmware
      url-base: https://github.com/zmkfirmware
    - name: georgego
      url-base: https://github.com/georgego
  projects:
    - name: zmk
      remote: georgogo
      revision: main
      import: app/west.yml
  self:
    path: config
```
